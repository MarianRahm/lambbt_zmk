## config/boards/shields/lambbt/Kconfig.shield
```kconfig
config SHIELD_LAMBBT_LEFT
	def_bool $(shields_list_contains,lambbt_left)

config SHIELD_LAMBBT_RIGHT
	def_bool $(shields_list_contains,lambbt_right)

config SHIELD_LAMBBT_DONGLE
	def_bool $(shields_list_contains,lambbt_dongle)
```
